## base_external/package/ldd/Config.in
```kconfig
config BR2_PACKAGE_LDD
	bool "LDD Assignments"
	help
	  Includes the misc_modules and scull modules from the Linux assignment 7 to buildrootfs.
	  Device Drivers book.
```
